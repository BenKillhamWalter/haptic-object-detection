/*
 * ================================================================
 *  PROSTHETIC HAND - INFERENCE FIRMWARE
 *  File: inference.ino
 * ================================================================
 *
 *  Prerequisites:
 *    model.h, model_config.h and class_names.h must be in this folder.
 *    They are generated by train_and_export.py.
 *
 *  Hardware layout: identical to data_collection.ino
 *    OpenRB-150 + XM430-W350-R + TCA9548A + 6x MLX90393
 *
 *  Usage:
 *    - On power-up: calibrates baseline with hand open and no object.
 *    - Send 'g' over Serial to grasp and classify.
 *    - Send 'r' to recalibrate baseline.
 *    - The hand returns to open position after classification.
 *
 *  Feature vector: 56 values, same order as train_and_export.py
 *    [0-17]  sensor deltas at t1
 *    [18-23] sensor magnitudes at t1
 *    [24]    encoder at t1
 *    [25-42] sensor deltas at t2
 *    [43-48] sensor magnitudes at t2
 *    [49]    encoder at t2
 *    [50-55] magnitude change t2 - t1 per sensor
 *
 *  Event definitions:
 *    t1 = first meaningful contact.
 *    t2 = final stable grasp / steady hold point.
 * ================================================================
 */

#include <Wire.h>
#include "MLX90393.h"
#include <Dynamixel2Arduino.h>
#include <math.h>

#include "model.h"         // Generated by train_and_export.py
#include "model_config.h"  // Generated by train_and_export.py
#include "class_names.h"   // Generated by train_and_export.py

#ifndef MODEL_HAS_GLOBAL_PREDICT
MODEL_CLASS classifier;
#endif

// ==================================================================
// TUNABLE PARAMETERS - keep consistent with data_collection.ino
// ==================================================================

const float OPEN_POS_DEG       = 33.0f;
const float CLOSE_POS_DEG      = 90.0f;
const float GRASP_SPEED_RPM    = 10.0f;

const uint32_t GRASP_TIMEOUT_MS   = 5000;
const uint32_t HOLD_DURATION_MS   = 800;
const float    CONTACT_THRESHOLD  = 40.0f;
const float    ENCODER_STILL_DEG  = 0.5f;
const uint8_t  ENCODER_STILL_COUNT = 5;
const uint32_t SAMPLE_INTERVAL_MS = 20;
const int      BASELINE_SAMPLES   = 40;

// ==================================================================
// SYSTEM CONSTANTS
// ==================================================================

#define DXL_SERIAL   Serial1
#define DEBUG_SERIAL Serial
#define DXL_DIR_PIN  2
#define TCA_ADDR     0x70
#define MOTOR_ID     1
#define NUM_SENSORS  6
#define NUM_FEATURES 56

// ==================================================================
// SENSOR OBJECTS
// ==================================================================

MLX90393 mlx_idx1, mlx_idx2;   // Strip 1, TCA ch0: Index ID1, ID2
MLX90393 mlx_thb1, mlx_thb2;   // Strip 1, TCA ch0: Thumb ID3, ID4
MLX90393 mlx_mid1, mlx_mid2;   // Strip 2, TCA ch1: Middle ID1, ID2

MLX90393::txyz data;
float baseline[NUM_SENSORS][3];

// ==================================================================
// DYNAMIXEL
// ==================================================================

Dynamixel2Arduino dxl(DXL_SERIAL, DXL_DIR_PIN);
using namespace ControlTableItem;

// ==================================================================
// SETUP
// ==================================================================

void setup() {
  DEBUG_SERIAL.begin(115200);
  while (!DEBUG_SERIAL && millis() < 4000) {}

  DEBUG_SERIAL.println(F("# Prosthetic Hand - Inference Firmware"));
  DEBUG_SERIAL.println(F("# Initialising hardware..."));

  Wire.begin();
  initMotor();
  initSensors();
  calibrateBaseline();
  moveToOpen();
  delay(700);

  DEBUG_SERIAL.println(F("# Ready. Send 'g' to grasp/classify, or 'r' to recalibrate baseline."));
}

// ==================================================================
// MAIN LOOP
// ==================================================================

void loop() {
  if (!DEBUG_SERIAL.available()) {
    return;
  }

  char c = DEBUG_SERIAL.read();

  if (c == 'g' || c == 'G') {
    runClassification();
  } else if (c == 'r' || c == 'R') {
    DEBUG_SERIAL.println(F("# Recalibrating baseline. Keep hand open and remove object."));
    moveToOpen();
    delay(700);
    calibrateBaseline();
    DEBUG_SERIAL.println(F("# Ready."));
  }
}

// ==================================================================
// CLASSIFICATION GRASP
// ==================================================================

void runClassification() {
  DEBUG_SERIAL.println(F("# Grasp start."));

  float feat_t1_dx[NUM_SENSORS] = {0};
  float feat_t1_dy[NUM_SENSORS] = {0};
  float feat_t1_dz[NUM_SENSORS] = {0};
  float feat_t2_dx[NUM_SENSORS] = {0};
  float feat_t2_dy[NUM_SENSORS] = {0};
  float feat_t2_dz[NUM_SENSORS] = {0};
  float enc_t1 = 0.0f;
  float enc_t2 = 0.0f;

  bool t1_captured = false;
  bool t2_captured = false;
  bool stable_detected = false;

  uint8_t still_count = 0;
  float prev_enc = getEncoderDeg();

  uint32_t grasp_start = millis();
  uint32_t timeout_end = grasp_start + GRASP_TIMEOUT_MS;
  uint32_t next_sample = millis();
  uint32_t hold_start = 0;

  dxl.setGoalPosition(MOTOR_ID, CLOSE_POS_DEG, UNIT_DEGREE);

  while (true) {
    uint32_t now = millis();

    if (!stable_detected && now > timeout_end) {
      DEBUG_SERIAL.println(F("# WARNING: Timeout. No final stable grasp was detected."));
      break;
    }

    if (now < next_sample) {
      continue;
    }
    next_sample += SAMPLE_INTERVAL_MS;

    uint32_t ts = now - grasp_start;
    float enc = getEncoderDeg();

    float dx[NUM_SENSORS], dy[NUM_SENSORS], dz[NUM_SENSORS];
    readAllSensors(dx, dy, dz);

    // t1 = first meaningful contact.
    if (!t1_captured) {
      int contact_sensor = detectContactSensor(dx, dy, dz);
      if (contact_sensor >= 0) {
        enc_t1 = enc;
        copySensorSnapshot(dx, dy, dz, feat_t1_dx, feat_t1_dy, feat_t1_dz);
        t1_captured = true;

        DEBUG_SERIAL.print(F("# t1 captured at "));
        DEBUG_SERIAL.print(ts);
        DEBUG_SERIAL.print(F(" ms, sensor="));
        DEBUG_SERIAL.println(contact_sensor);
      }
    }

    // Detect stable motor state first, then keep holding. The final
    // sample after HOLD_DURATION_MS becomes t2.
    if (t1_captured && !stable_detected) {
      float delta_enc = fabs(enc - prev_enc);
      if (delta_enc < ENCODER_STILL_DEG) {
        still_count++;
        if (still_count >= ENCODER_STILL_COUNT) {
          stable_detected = true;
          hold_start = now;
          DEBUG_SERIAL.print(F("# Stable grasp detected at "));
          DEBUG_SERIAL.print(ts);
          DEBUG_SERIAL.println(F(" ms. Holding before final t2 capture."));
        }
      } else {
        still_count = 0;
      }
    }

    if (stable_detected && !t2_captured && (now - hold_start >= HOLD_DURATION_MS)) {
      enc_t2 = enc;
      copySensorSnapshot(dx, dy, dz, feat_t2_dx, feat_t2_dy, feat_t2_dz);
      t2_captured = true;

      DEBUG_SERIAL.print(F("# t2 captured at final stable hold point, "));
      DEBUG_SERIAL.print(ts);
      DEBUG_SERIAL.println(F(" ms."));
      break;
    }

    prev_enc = enc;
  }

  moveToOpen();

  if (!t1_captured || !t2_captured) {
    DEBUG_SERIAL.println(F("RESULT: UNKNOWN (t1 or t2 not detected - tune threshold/timing)"));
    delay(500);
    return;
  }

  float features[NUM_FEATURES];
  extractFeatures(
    feat_t1_dx, feat_t1_dy, feat_t1_dz, enc_t1,
    feat_t2_dx, feat_t2_dy, feat_t2_dz, enc_t2,
    features
  );

#ifdef MODEL_HAS_GLOBAL_PREDICT
  int predicted_class = predict(features);
#else
  int predicted_class = classifier.predict(features);
#endif

  DEBUG_SERIAL.print(F("RESULT: "));
  if (predicted_class >= 0 && predicted_class < NUM_CLASSES) {
    DEBUG_SERIAL.println(CLASS_NAMES[predicted_class]);
  } else {
    DEBUG_SERIAL.println(F("UNKNOWN (model returned invalid class index)"));
  }

  delay(500);
  DEBUG_SERIAL.println(F("# Ready. Send 'g' for next classification."));
}

void copySensorSnapshot(float src_dx[], float src_dy[], float src_dz[],
                        float dst_dx[], float dst_dy[], float dst_dz[]) {
  for (int i = 0; i < NUM_SENSORS; i++) {
    dst_dx[i] = src_dx[i];
    dst_dy[i] = src_dy[i];
    dst_dz[i] = src_dz[i];
  }
}

int detectContactSensor(float dx[], float dy[], float dz[]) {
  for (int i = 0; i < NUM_SENSORS; i++) {
    if (fabs(dx[i]) > CONTACT_THRESHOLD ||
        fabs(dy[i]) > CONTACT_THRESHOLD ||
        fabs(dz[i]) > CONTACT_THRESHOLD) {
      return i;
    }
  }
  return -1;
}

// ==================================================================
// FEATURE EXTRACTION
// Must match train_and_export.py exactly.
// ==================================================================

void extractFeatures(
  float* t1_dx, float* t1_dy, float* t1_dz, float enc_t1,
  float* t2_dx, float* t2_dy, float* t2_dz, float enc_t2,
  float* features
) {
  int idx = 0;

  // Group A: t1 raw deltas [0-17]
  for (int i = 0; i < NUM_SENSORS; i++) {
    features[idx++] = t1_dx[i];
    features[idx++] = t1_dy[i];
    features[idx++] = t1_dz[i];
  }

  // Group A: t1 magnitudes [18-23]
  float mags_t1[NUM_SENSORS];
  for (int i = 0; i < NUM_SENSORS; i++) {
    mags_t1[i] = sqrt(t1_dx[i] * t1_dx[i] + t1_dy[i] * t1_dy[i] + t1_dz[i] * t1_dz[i]);
    features[idx++] = mags_t1[i];
  }

  // Group A: encoder at t1 [24]
  features[idx++] = enc_t1;

  // Group B: t2 raw deltas [25-42]
  for (int i = 0; i < NUM_SENSORS; i++) {
    features[idx++] = t2_dx[i];
    features[idx++] = t2_dy[i];
    features[idx++] = t2_dz[i];
  }

  // Group B: t2 magnitudes [43-48]
  float mags_t2[NUM_SENSORS];
  for (int i = 0; i < NUM_SENSORS; i++) {
    mags_t2[i] = sqrt(t2_dx[i] * t2_dx[i] + t2_dy[i] * t2_dy[i] + t2_dz[i] * t2_dz[i]);
    features[idx++] = mags_t2[i];
  }

  // Group B: encoder at t2 [49]
  features[idx++] = enc_t2;

  // Group C: stiffness proxy [50-55]
  for (int i = 0; i < NUM_SENSORS; i++) {
    features[idx++] = mags_t2[i] - mags_t1[i];
  }

  // idx should be 56 here.
}

// ==================================================================
// SENSOR FUNCTIONS
// ==================================================================

void tcaselect(uint8_t ch) {
  if (ch > 7) return;
  Wire.beginTransmission(TCA_ADDR);
  Wire.write(1 << ch);
  Wire.endTransmission();
}

void initSensors() {
  DEBUG_SERIAL.println(F("# Initialising sensors..."));

  tcaselect(0);
  mlx_idx1.begin(0, 0); mlx_idx1.setOverSampling(0); mlx_idx1.setDigitalFiltering(0);
  mlx_idx2.begin(0, 1); mlx_idx2.setOverSampling(0); mlx_idx2.setDigitalFiltering(0);
  mlx_thb1.begin(1, 0); mlx_thb1.setOverSampling(0); mlx_thb1.setDigitalFiltering(0);
  mlx_thb2.begin(1, 1); mlx_thb2.setOverSampling(0); mlx_thb2.setDigitalFiltering(0);

  tcaselect(1);
  mlx_mid1.begin(0, 0); mlx_mid1.setOverSampling(0); mlx_mid1.setDigitalFiltering(0);
  mlx_mid2.begin(0, 1); mlx_mid2.setOverSampling(0); mlx_mid2.setDigitalFiltering(0);

  delay(100);
  DEBUG_SERIAL.println(F("# Sensors OK."));
}

void calibrateBaseline() {
  DEBUG_SERIAL.println(F("# Calibrating baseline..."));

  float sumX[NUM_SENSORS] = {0};
  float sumY[NUM_SENSORS] = {0};
  float sumZ[NUM_SENSORS] = {0};

  for (int s = 0; s < BASELINE_SAMPLES; s++) {
    tcaselect(0);
    mlx_idx1.readData(data); sumX[0] += data.x; sumY[0] += data.y; sumZ[0] += data.z;
    mlx_idx2.readData(data); sumX[1] += data.x; sumY[1] += data.y; sumZ[1] += data.z;
    mlx_thb1.readData(data); sumX[2] += data.x; sumY[2] += data.y; sumZ[2] += data.z;
    mlx_thb2.readData(data); sumX[3] += data.x; sumY[3] += data.y; sumZ[3] += data.z;

    tcaselect(1);
    mlx_mid1.readData(data); sumX[4] += data.x; sumY[4] += data.y; sumZ[4] += data.z;
    mlx_mid2.readData(data); sumX[5] += data.x; sumY[5] += data.y; sumZ[5] += data.z;

    delay(SAMPLE_INTERVAL_MS);
  }

  for (int i = 0; i < NUM_SENSORS; i++) {
    baseline[i][0] = sumX[i] / BASELINE_SAMPLES;
    baseline[i][1] = sumY[i] / BASELINE_SAMPLES;
    baseline[i][2] = sumZ[i] / BASELINE_SAMPLES;
  }

  DEBUG_SERIAL.println(F("# Baseline done."));
}

void readAllSensors(float dx[], float dy[], float dz[]) {
  tcaselect(0);
  mlx_idx1.readData(data); dx[0] = data.x - baseline[0][0]; dy[0] = data.y - baseline[0][1]; dz[0] = data.z - baseline[0][2];
  mlx_idx2.readData(data); dx[1] = data.x - baseline[1][0]; dy[1] = data.y - baseline[1][1]; dz[1] = data.z - baseline[1][2];
  mlx_thb1.readData(data); dx[2] = data.x - baseline[2][0]; dy[2] = data.y - baseline[2][1]; dz[2] = data.z - baseline[2][2];
  mlx_thb2.readData(data); dx[3] = data.x - baseline[3][0]; dy[3] = data.y - baseline[3][1]; dz[3] = data.z - baseline[3][2];

  tcaselect(1);
  mlx_mid1.readData(data); dx[4] = data.x - baseline[4][0]; dy[4] = data.y - baseline[4][1]; dz[4] = data.z - baseline[4][2];
  mlx_mid2.readData(data); dx[5] = data.x - baseline[5][0]; dy[5] = data.y - baseline[5][1]; dz[5] = data.z - baseline[5][2];
}

// ==================================================================
// MOTOR FUNCTIONS
// ==================================================================

void initMotor() {
  DEBUG_SERIAL.println(F("# Initialising motor..."));
  dxl.begin(57600);
  dxl.setPortProtocolVersion(2.0);

  if (!dxl.ping(MOTOR_ID)) {
    DEBUG_SERIAL.println(F("# ERROR: XM430 not found. Check power, cable, ID=1 and baud=57600."));
    while (true) delay(1000);
  }

  dxl.torqueOff(MOTOR_ID);
  dxl.setOperatingMode(MOTOR_ID, OP_POSITION);

  int32_t vel_raw = (int32_t)(GRASP_SPEED_RPM / 0.229f);
  dxl.writeControlTableItem(PROFILE_VELOCITY, MOTOR_ID, vel_raw);

  dxl.torqueOn(MOTOR_ID);
  DEBUG_SERIAL.println(F("# Motor OK."));
}

void moveToOpen() {
  dxl.setGoalPosition(MOTOR_ID, OPEN_POS_DEG, UNIT_DEGREE);
}

float getEncoderDeg() {
  return dxl.getPresentPosition(MOTOR_ID, UNIT_DEGREE);
}
