/*
 * ================================================================
 *  PROSTHETIC HAND - INFERENCE FIRMWARE  (4-sensor, amplified)
 *  File: inference.ino
 * ================================================================
 *
 *  Prerequisites:
 *    model.h, model_config.h and class_names.h must be in this folder.
 *    They are generated by train_and_export.py.
 *
 *  Hardware layout:
 *    OpenRB-150 (SAMD21, 32KB SRAM, 256KB Flash)
 *    Dynamixel XM430-W350-R (ID 1, Protocol 2.0)
 *    TCA9548A I2C multiplexer at 0x70 - 2 isolated channels.
 *      Channel 0 - Index finger  (sensors 0, 1: ID1, ID2)
 *      Channel 1 - Thumb finger  (sensors 2, 3: ID3, ID4)
 *    (Middle finger removed - hardware was unrecoverable.)
 *
 *  Trained classes (from class_names.h):
 *      cube_soft, cube_stiff, cylinder_soft, cylinder_stiff, no_object
 *
 *  Output:
 *      "RESULT: No object detected"      when predicted == no_object
 *      "RESULT: <class>"                 when normal prediction
 *      "RESULT: unknown_object (<reason>)" when hard failure
 *
 *  Sensor amplification (must match data_collection.ino exactly):
 *      setGainSel(2), setResolution(0,0,0), setOverSampling(2),
 *      setDigitalFiltering(2), setTemperatureCompensation(1)
 *
 *  Feature vector (NUM_FEATURES = 57), same order as train_and_export.py:
 *    [0..11]   peak_abs of 12 magnetic deltas across whole grasp
 *    [12..23]  mean_abs of 12 magnetic deltas across whole grasp
 *    [24..35]  RMS of 12 magnetic deltas across whole grasp
 *    [36..47]  raw deltas at t2 (final stable hold)
 *    [48..51]  4 sensor magnitudes at t2
 *    [52]      enc_t2 (encoder angle at t2)
 *    [53]      load_t2
 *    [54]      current_t2
 *    [55]      time_to_stall_ms (when motor stabilized after t1)
 *    [56]      enc_t1
 * ================================================================
 */

#include <Wire.h>
#include "MLX90393.h"
#include <Dynamixel2Arduino.h>
#include <math.h>

#include "model.h"         // Generated by train_and_export.py
#include "model_config.h"  // Generated by train_and_export.py (defines MODEL_NUM_FEATURES)
#include "class_names.h"   // Generated by train_and_export.py

#ifndef MODEL_HAS_GLOBAL_PREDICT
MODEL_CLASS classifier;
#endif

// ==================================================================
// TUNABLE PARAMETERS - must match data_collection.ino
// ==================================================================

const float OPEN_POS_DEG       = 60.0f;
const float CLOSE_POS_DEG      = 110.0f;
const float GRASP_SPEED_RPM    = 10.0f;
const float CALIB_SPEED_RPM    = 3.0f;  // slow sweep for motor-field profile

const uint32_t GRASP_TIMEOUT_MS   = 5000;
const uint32_t HOLD_DURATION_MS   = 800;

// POST-SUBTRACTION thresholds. MUST match data_collection.ino.
// Sized for residual noise after motor_field_profile is subtracted (~15-30 uT).
// If profile not yet calibrated, readAllSensors falls back to static baseline
// and these thresholds will be too low. Send 'r' before any grasp.
// 2026-05-10 round 2 - matches data_collection. Raised dz on index sensors
// to clear empty-grasp residuals (60+ uT on Z), CONFIRM raised to 8.
const float CONTACT_THRESHOLDS[4][3] = {
  {40.0f, 40.0f, 65.0f},  // s0 Index ID1
  {40.0f, 40.0f, 60.0f},  // s1 Index ID2
  {25.0f, 25.0f, 35.0f},  // s2 Thumb ID3 (base)
  {25.0f, 25.0f, 30.0f}   // s3 Thumb ID4 (TIP - most sensitive)
};

const bool CONTACT_ENABLED[4][3] = {
  {true,  true,  true },  // s0 Index ID1: all three
  {true,  true,  true },  // s1 Index ID2: all three (re-enabled 2026-05-09)
  {true,  true,  true },  // s2 Thumb ID3: all three
  {true,  true,  true }   // s3 Thumb ID4: all three
};

const uint32_t CONTACT_IGNORE_MS       = 150;
const int      CONTACT_CONFIRM_SAMPLES = 8;  // 160 ms sustained, matches data_collection

const float   ENCODER_STILL_DEG   = 0.5f;
const uint8_t ENCODER_STILL_COUNT = 5;

const float   ENCODER_MOVING_MIN_DEG = 1.0f;
const float   ENCODER_STALL_DEG      = 0.3f;
const uint8_t ENCODER_STALL_CONFIRM  = 4;

const uint32_t SAMPLE_INTERVAL_MS = 20;
const int      BASELINE_SAMPLES   = 80;

// Motor-field profile bins. MUST match data_collection.ino so a profile
// captured during data collection is interchangeable with one captured at
// inference time (in practice each session calibrates its own).
const int PROFILE_BIN_DEG_MIN = (int)OPEN_POS_DEG;   // 60
const int PROFILE_BIN_DEG_MAX = (int)CLOSE_POS_DEG;  // 110
const int PROFILE_NUM_BINS    = PROFILE_BIN_DEG_MAX - PROFILE_BIN_DEG_MIN + 1;

// ==================================================================
// SYSTEM CONSTANTS
// ==================================================================

#define DXL_SERIAL   Serial1
#define DEBUG_SERIAL Serial
#define DXL_DIR_PIN  2
#define TCA_ADDR     0x70
#define MOTOR_ID     1
#define NUM_SENSORS  4
#define NUM_CHANNELS 12  // 4 sensors x 3 axes
#define NUM_FEATURES 57

// Set to 1 to print all 57 features over serial right before predict().
// Useful for verifying that inference computes the same features as training.
// Compare against a row from a training CSV to validate feature parity.
#define DUMP_FEATURES_FOR_DEBUG 1

#define TCA_CH_INDEX  0
#define TCA_CH_THUMB  1

// Compile-time check: feature count must match exported model.
#if defined(MODEL_NUM_FEATURES) && (MODEL_NUM_FEATURES != NUM_FEATURES)
  #error "MODEL_NUM_FEATURES from model_config.h does not match NUM_FEATURES. Re-run train_and_export.py and re-flash."
#endif

// ==================================================================
// SENSOR OBJECTS
// ==================================================================

MLX90393 mlx_idx1;
MLX90393 mlx_idx2;
MLX90393 mlx_thb1;
MLX90393 mlx_thb2;

MLX90393::txyz data;
float baseline[NUM_SENSORS][3];

bool sensor_present[NUM_SENSORS] = {false, false, false, false};

// Motor-field profile (per-encoder-degree raw sensor mean for empty hand).
// Calibrated by 'r' command. See header comment in data_collection.ino.
float    motor_field_profile[PROFILE_NUM_BINS][NUM_SENSORS][3];
uint16_t profile_count[PROFILE_NUM_BINS];
bool     profile_calibrated = false;

// ==================================================================
// DYNAMIXEL
// ==================================================================

Dynamixel2Arduino dxl(DXL_SERIAL, DXL_DIR_PIN);
using namespace ControlTableItem;

// ==================================================================
// CONTACT DETECTION STATE - reset each grasp
// ==================================================================

int  contactCounter[NUM_SENSORS][3];
bool axisContact[NUM_SENSORS][3];
bool sensorContact[NUM_SENSORS];
uint8_t encoderStallCounter = 0;

// ==================================================================
// SETUP
// ==================================================================

void setup() {
  DEBUG_SERIAL.begin(115200);
  while (!DEBUG_SERIAL && millis() < 4000) {}

  DEBUG_SERIAL.println(F("# Prosthetic Hand - Inference Firmware (4-sensor)"));
  DEBUG_SERIAL.print  (F("# NUM_FEATURES = ")); DEBUG_SERIAL.println(NUM_FEATURES);
#ifdef MODEL_NUM_FEATURES
  DEBUG_SERIAL.print  (F("# MODEL_NUM_FEATURES = ")); DEBUG_SERIAL.println(MODEL_NUM_FEATURES);
  if (MODEL_NUM_FEATURES != NUM_FEATURES) {
    DEBUG_SERIAL.println(F("# ERROR: MODEL_NUM_FEATURES != NUM_FEATURES. Halting."));
    while (true) { delay(1000); }
  }
#else
  DEBUG_SERIAL.println(F("# WARNING: MODEL_NUM_FEATURES not defined. Re-run train_and_export.py."));
#endif

  DEBUG_SERIAL.print(F("# Classes: "));
  for (int i = 0; i < NUM_CLASSES; i++) {
    DEBUG_SERIAL.print(CLASS_NAMES[i]);
    if (i < NUM_CLASSES - 1) DEBUG_SERIAL.print(F(", "));
  }
  DEBUG_SERIAL.println();

  Wire.begin();
  // Give MLX90393 chips time to wake up before any I2C transactions.
  delay(150);
  // Put TCA9548A in a known state.
  tcaDisableAll();

  initMotor();
  initSensors();
  clearMotorFieldProfile();   // start uncalibrated; user must send 'r'
  calibrateBaseline();        // static baseline (fallback)
  moveToOpen();
  delay(700);

  DEBUG_SERIAL.println(F("# Ready. Commands: 'g'=grasp/classify, 'r'=motor-field profile sweep (REQUIRED)."));
  DEBUG_SERIAL.println(F("# WARNING: profile NOT calibrated yet. Send 'r' (no object in hand) before any grasp."));
}

// ==================================================================
// MAIN LOOP
// ==================================================================

void loop() {
  if (!DEBUG_SERIAL.available()) {
    return;
  }

  char c = DEBUG_SERIAL.read();

  if (c == 'g' || c == 'G') {
    runClassification();
  } else if (c == 'r' || c == 'R') {
    // 'r' triggers full motor-field profile sweep (replaces simple baseline).
    calibrateMotorFieldProfile();
    DEBUG_SERIAL.println(F("# Ready."));
  }
}

// ==================================================================
// CLASSIFICATION GRASP
// ==================================================================

void resetContactDetection() {
  for (int i = 0; i < NUM_SENSORS; i++) {
    sensorContact[i] = false;
    for (int j = 0; j < 3; j++) {
      axisContact[i][j]    = false;
      contactCounter[i][j] = 0;
    }
  }
  encoderStallCounter = 0;
}

int updateMagneticContactDetection(float dx[], float dy[], float dz[], uint32_t elapsedMs) {
  if (elapsedMs < CONTACT_IGNORE_MS) return -1;
  float vals[3];
  int firstNew = -1;
  for (int i = 0; i < NUM_SENSORS; i++) {
    vals[0] = dx[i]; vals[1] = dy[i]; vals[2] = dz[i];
    for (int j = 0; j < 3; j++) {
      if (!CONTACT_ENABLED[i][j] || axisContact[i][j]) continue;
      if (fabs(vals[j]) >= CONTACT_THRESHOLDS[i][j]) {
        if (++contactCounter[i][j] >= CONTACT_CONFIRM_SAMPLES) {
          axisContact[i][j] = true;
          if (!sensorContact[i]) {
            sensorContact[i] = true;
            if (firstNew < 0) firstNew = i;
          }
        }
      } else {
        contactCounter[i][j] = 0;
      }
    }
  }
  return firstNew;
}

void runClassification() {
  DEBUG_SERIAL.println(F("# Grasp start."));

  resetContactDetection();

  // Snapshots at t1 and t2
  float feat_t2_dx[NUM_SENSORS] = {0};
  float feat_t2_dy[NUM_SENSORS] = {0};
  float feat_t2_dz[NUM_SENSORS] = {0};
  float enc_t1 = 0.0f, enc_t2 = 0.0f;
  float load_t1 = 0.0f, load_t2 = 0.0f;
  float current_t1 = 0.0f, current_t2 = 0.0f;
  uint32_t time_to_stall_ms = 0;
  uint8_t  t1_source = 0;

  // Running time-series statistics across whole grasp (per channel)
  float peak_abs[NUM_CHANNELS] = {0};
  float sum_abs[NUM_CHANNELS]  = {0};
  float sum_sq[NUM_CHANNELS]   = {0};
  uint16_t sample_count = 0;

  bool t1_detected = false;
  bool t2_captured = false;
  bool stable_detected = false;

  uint8_t still_count = 0;

  float enc_start = getEncoderDeg();
  float prev_enc  = enc_start;

  uint32_t grasp_start = millis();
  uint32_t timeout_end = grasp_start + GRASP_TIMEOUT_MS;
  uint32_t next_sample = millis();
  uint32_t hold_start = 0;

  dxl.setGoalPosition(MOTOR_ID, CLOSE_POS_DEG, UNIT_DEGREE);

  while (true) {
    uint32_t now = millis();

    if (!stable_detected && now > timeout_end) {
      DEBUG_SERIAL.println(F("# WARNING: Timeout. No final stable grasp was detected."));
      break;
    }

    if (now < next_sample) {
      continue;
    }
    next_sample += SAMPLE_INTERVAL_MS;

    uint32_t ts = now - grasp_start;
    float enc = getEncoderDeg();

    float dx[NUM_SENSORS], dy[NUM_SENSORS], dz[NUM_SENSORS];
    readAllSensors(dx, dy, dz);

    // ---- Update running time-series stats ----
    float vals[NUM_CHANNELS];
    for (int i = 0; i < NUM_SENSORS; i++) {
      vals[i*3 + 0] = dx[i];
      vals[i*3 + 1] = dy[i];
      vals[i*3 + 2] = dz[i];
    }
    for (int k = 0; k < NUM_CHANNELS; k++) {
      float a = fabs(vals[k]);
      if (a > peak_abs[k]) peak_abs[k] = a;
      sum_abs[k] += a;
      sum_sq[k]  += vals[k] * vals[k];
    }
    sample_count++;

    // ---- t1 detection: dual path ----
    if (!t1_detected) {
      bool magnetic_hit = (updateMagneticContactDetection(dx, dy, dz, ts) >= 0);

      bool stall_hit = false;
      bool past_ignore_window = (ts >= CONTACT_IGNORE_MS);
      bool hand_has_moved     = (fabs(enc - enc_start) >= ENCODER_MOVING_MIN_DEG);
      if (past_ignore_window && hand_has_moved) {
        float delta_enc = fabs(enc - prev_enc);
        if (delta_enc < ENCODER_STALL_DEG) {
          encoderStallCounter++;
          if (encoderStallCounter >= ENCODER_STALL_CONFIRM) {
            stall_hit = true;
          }
        } else {
          encoderStallCounter = 0;
        }
      } else {
        encoderStallCounter = 0;
      }

      if (magnetic_hit || stall_hit) {
        t1_detected      = true;
        // NOTE: time_to_stall_ms is set LATER (when stable_detected) to match
        // data_collection.ino exactly. Setting it here would bias training vs
        // inference because training reads it from the CSV "time_to_stall_ms"
        // column, which is written at stable detection, not at t1.
        enc_t1           = enc;
        load_t1    = (float)dxl.readControlTableItem(PRESENT_LOAD,    MOTOR_ID);
        current_t1 = (float)dxl.readControlTableItem(PRESENT_CURRENT, MOTOR_ID);

        if (magnetic_hit && stall_hit)      t1_source = 3;
        else if (magnetic_hit)              t1_source = 1;
        else                                t1_source = 2;

        DEBUG_SERIAL.print(F("# t1 captured ("));
        if (t1_source == 1) DEBUG_SERIAL.print(F("magnetic"));
        else if (t1_source == 2) DEBUG_SERIAL.print(F("encoder_stall"));
        else DEBUG_SERIAL.print(F("magnetic+encoder_stall"));
        DEBUG_SERIAL.print(F(") at "));
        DEBUG_SERIAL.print(ts);
        DEBUG_SERIAL.print(F(" ms enc="));
        DEBUG_SERIAL.print(enc_t1, 2);
        DEBUG_SERIAL.print(F(" load="));
        DEBUG_SERIAL.println(load_t1, 1);
      }
    }

    // ---- Detect stable motor state ----
    if (t1_detected && !stable_detected) {
      float delta_enc = fabs(enc - prev_enc);
      if (delta_enc < ENCODER_STILL_DEG) {
        still_count++;
        if (still_count >= ENCODER_STILL_COUNT) {
          stable_detected = true;
          hold_start = now;
          time_to_stall_ms = ts;  // Match data_collection.ino: set on stability, not at t1.
          DEBUG_SERIAL.print(F("# Stable grasp detected at "));
          DEBUG_SERIAL.print(ts);
          DEBUG_SERIAL.println(F(" ms. Holding before final t2 capture."));
        }
      } else {
        still_count = 0;
      }
    }

    // ---- Capture t2 at end of hold ----
    if (stable_detected && !t2_captured && (now - hold_start >= HOLD_DURATION_MS)) {
      enc_t2 = enc;
      for (int i = 0; i < NUM_SENSORS; i++) {
        feat_t2_dx[i] = dx[i];
        feat_t2_dy[i] = dy[i];
        feat_t2_dz[i] = dz[i];
      }
      load_t2    = (float)dxl.readControlTableItem(PRESENT_LOAD,    MOTOR_ID);
      current_t2 = (float)dxl.readControlTableItem(PRESENT_CURRENT, MOTOR_ID);
      t2_captured = true;

      DEBUG_SERIAL.print(F("# t2 captured at "));
      DEBUG_SERIAL.print(ts);
      DEBUG_SERIAL.print(F(" ms enc="));
      DEBUG_SERIAL.print(enc_t2, 2);
      DEBUG_SERIAL.print(F(" load="));
      DEBUG_SERIAL.println(load_t2, 1);

      // Diagnostic: how far did the motor actually travel?
      // Open  ~ 60 deg, Close target = 120 deg (60 deg of motion expected).
      // If travelled << 55 deg with no object, motor is stalling early
      // (mechanical / power problem) and inference will mispredict.
      DEBUG_SERIAL.print(F("# Motor travel: enc_start="));
      DEBUG_SERIAL.print(enc_start, 2);
      DEBUG_SERIAL.print(F("  enc_t2="));
      DEBUG_SERIAL.print(enc_t2, 2);
      DEBUG_SERIAL.print(F("  delta="));
      DEBUG_SERIAL.print(enc_t2 - enc_start, 2);
      DEBUG_SERIAL.print(F(" deg  target="));
      DEBUG_SERIAL.print(CLOSE_POS_DEG - enc_start, 2);
      DEBUG_SERIAL.print(F(" deg  reached "));
      DEBUG_SERIAL.print(100.0f * (enc_t2 - enc_start) / (CLOSE_POS_DEG - enc_start), 1);
      DEBUG_SERIAL.println(F("% of expected"));

      break;
    }

    prev_enc = enc;
  }

  moveToOpen();

  // ---- Decide output ----
  if (!t1_detected || !t2_captured) {
    DEBUG_SERIAL.println(F("RESULT: unknown_object (t1 or t2 not detected)"));
    delay(500);
    DEBUG_SERIAL.println(F("# Ready. Send 'g' for next classification."));
    return;
  }

  if (sample_count == 0) {
    DEBUG_SERIAL.println(F("RESULT: unknown_object (no samples collected)"));
    delay(500);
    DEBUG_SERIAL.println(F("# Ready. Send 'g' for next classification."));
    return;
  }

  // Finalize time-series stats.
  float mean_abs[NUM_CHANNELS];
  float rms[NUM_CHANNELS];
  for (int k = 0; k < NUM_CHANNELS; k++) {
    mean_abs[k] = sum_abs[k] / (float)sample_count;
    rms[k]      = sqrt(sum_sq[k] / (float)sample_count);
  }

  float features[NUM_FEATURES];
  extractFeatures(
    peak_abs, mean_abs, rms,
    feat_t2_dx, feat_t2_dy, feat_t2_dz,
    enc_t2, load_t2, current_t2,
    time_to_stall_ms, enc_t1,
    features
  );

#if DUMP_FEATURES_FOR_DEBUG
  DEBUG_SERIAL.print(F("# FEATURES:"));
  for (int i = 0; i < NUM_FEATURES; i++) {
    DEBUG_SERIAL.print(' ');
    DEBUG_SERIAL.print(features[i], 3);
  }
  DEBUG_SERIAL.println();
  DEBUG_SERIAL.print(F("# stable_time_ms="));
  DEBUG_SERIAL.print(time_to_stall_ms);
  DEBUG_SERIAL.print(F("  enc_t1="));
  DEBUG_SERIAL.print(enc_t1, 3);
  DEBUG_SERIAL.print(F("  enc_t2="));
  DEBUG_SERIAL.print(enc_t2, 3);
  DEBUG_SERIAL.print(F("  load_t2="));
  DEBUG_SERIAL.print(load_t2, 1);
  DEBUG_SERIAL.print(F("  current_t2="));
  DEBUG_SERIAL.println(current_t2, 1);
#endif

#ifdef MODEL_HAS_GLOBAL_PREDICT
  int predicted_class = predict(features);
#else
  int predicted_class = classifier.predict(features);
#endif

  DEBUG_SERIAL.print(F("RESULT: "));
  if (predicted_class < 0 || predicted_class >= NUM_CLASSES) {
    DEBUG_SERIAL.println(F("unknown_object (model returned invalid class index)"));
  } else {
    const char* name = CLASS_NAMES[predicted_class];
    if (strcmp(name, "no_object") == 0) {
      DEBUG_SERIAL.println(F("No object detected"));
    } else {
      DEBUG_SERIAL.println(name);
    }
  }

  delay(500);
  DEBUG_SERIAL.println(F("# Ready. Send 'g' for next classification."));
}

// ==================================================================
// FEATURE EXTRACTION
// ==================================================================
//
// Order MUST match build_dataset() in train_and_export.py:
//   [0..11]   peak_abs    (12)
//   [12..23]  mean_abs    (12)
//   [24..35]  rms         (12)
//   [36..47]  t2 deltas   (12)
//   [48..51]  t2 mags     (4)
//   [52]      enc_t2
//   [53]      load_t2
//   [54]      current_t2
//   [55]      time_to_stall_ms
//   [56]      enc_t1
//
void extractFeatures(
  float* peak_abs, float* mean_abs, float* rms,
  float* t2_dx, float* t2_dy, float* t2_dz,
  float enc_t2, float load_t2, float current_t2,
  uint32_t time_to_stall_ms, float enc_t1,
  float* features
) {
  int idx = 0;

  for (int k = 0; k < NUM_CHANNELS; k++) features[idx++] = peak_abs[k];
  for (int k = 0; k < NUM_CHANNELS; k++) features[idx++] = mean_abs[k];
  for (int k = 0; k < NUM_CHANNELS; k++) features[idx++] = rms[k];

  for (int i = 0; i < NUM_SENSORS; i++) {
    features[idx++] = t2_dx[i];
    features[idx++] = t2_dy[i];
    features[idx++] = t2_dz[i];
  }

  for (int i = 0; i < NUM_SENSORS; i++) {
    float m = sqrt(t2_dx[i]*t2_dx[i] + t2_dy[i]*t2_dy[i] + t2_dz[i]*t2_dz[i]);
    features[idx++] = m;
  }

  features[idx++] = enc_t2;
  features[idx++] = load_t2;
  features[idx++] = current_t2;
  features[idx++] = (float)time_to_stall_ms;
  features[idx++] = enc_t1;

  // idx should equal NUM_FEATURES (57) here.
}

// ==================================================================
// SENSOR FUNCTIONS
// ==================================================================

void tcaselect(uint8_t ch) {
  if (ch > 7) return;
  Wire.beginTransmission(TCA_ADDR);
  Wire.write(1 << ch);
  Wire.endTransmission();
  delayMicroseconds(100);
}

inline void applyAmpSettings(MLX90393& s) {
  s.setGainSel(2);
  s.setResolution(0, 0, 0);
  s.setOverSampling(2);
  s.setDigitalFiltering(2);
  s.setTemperatureCompensation(1);
}

// ---- Motor-field profile helpers (must match data_collection.ino) ----

inline int encToProfileBin(float enc) {
  int bin = (int)(enc + 0.5f) - PROFILE_BIN_DEG_MIN;
  if (bin < 0) return 0;
  if (bin >= PROFILE_NUM_BINS) return PROFILE_NUM_BINS - 1;
  return bin;
}

void clearMotorFieldProfile() {
  for (int b = 0; b < PROFILE_NUM_BINS; b++) {
    profile_count[b] = 0;
    for (int i = 0; i < NUM_SENSORS; i++)
      for (int j = 0; j < 3; j++)
        motor_field_profile[b][i][j] = 0.0f;
  }
  profile_calibrated = false;
}

void fillEmptyProfileBins() {
  for (int b = 0; b < PROFILE_NUM_BINS; b++) {
    if (profile_count[b] > 0) continue;
    int nearest = -1, nearest_dist = PROFILE_NUM_BINS + 1;
    for (int b2 = 0; b2 < PROFILE_NUM_BINS; b2++) {
      if (profile_count[b2] == 0) continue;
      int d = (b2 > b) ? (b2 - b) : (b - b2);
      if (d < nearest_dist) { nearest_dist = d; nearest = b2; }
    }
    if (nearest >= 0) {
      for (int i = 0; i < NUM_SENSORS; i++)
        for (int j = 0; j < 3; j++)
          motor_field_profile[b][i][j] = motor_field_profile[nearest][i][j];
    }
  }
}

void readAllSensorsRaw(float rawX[], float rawY[], float rawZ[]) {
  tcaselect(TCA_CH_INDEX);
  if (sensor_present[0]) { mlx_idx1.readData(data); rawX[0] = data.x; rawY[0] = data.y; rawZ[0] = data.z; }
  else { rawX[0] = 0; rawY[0] = 0; rawZ[0] = 0; }
  if (sensor_present[1]) { mlx_idx2.readData(data); rawX[1] = data.x; rawY[1] = data.y; rawZ[1] = data.z; }
  else { rawX[1] = 0; rawY[1] = 0; rawZ[1] = 0; }
  tcaselect(TCA_CH_THUMB);
  if (sensor_present[2]) { mlx_thb1.readData(data); rawX[2] = data.x; rawY[2] = data.y; rawZ[2] = data.z; }
  else { rawX[2] = 0; rawY[2] = 0; rawZ[2] = 0; }
  if (sensor_present[3]) { mlx_thb2.readData(data); rawX[3] = data.x; rawY[3] = data.y; rawZ[3] = data.z; }
  else { rawX[3] = 0; rawY[3] = 0; rawZ[3] = 0; }
}

bool calibrateMotorFieldProfile() {
  DEBUG_SERIAL.println(F("# ============================================================"));
  DEBUG_SERIAL.println(F("# MOTOR-FIELD PROFILE CALIBRATION"));
  DEBUG_SERIAL.println(F("# REMOVE ALL OBJECTS from the hand."));
  DEBUG_SERIAL.println(F("# Send 'y' to begin or any other key to cancel."));
  DEBUG_SERIAL.println(F("# ============================================================"));

  while (DEBUG_SERIAL.available()) DEBUG_SERIAL.read();

  uint32_t deadline = millis() + 30000UL;
  while (!DEBUG_SERIAL.available()) {
    if (millis() > deadline) {
      DEBUG_SERIAL.println(F("# Calibration timed out (no confirm). Aborted."));
      return false;
    }
    delay(20);
  }
  // Read a single char (matches the inference loop input style).
  char c = (char)DEBUG_SERIAL.read();
  // Drain remainder
  while (DEBUG_SERIAL.available()) DEBUG_SERIAL.read();
  if (c != 'y' && c != 'Y') {
    DEBUG_SERIAL.println(F("# Calibration aborted by user."));
    return false;
  }

  clearMotorFieldProfile();

  moveToOpen();
  delay(800);

  int32_t slow_vel = (int32_t)(CALIB_SPEED_RPM / 0.229f);
  int32_t fast_vel = (int32_t)(GRASP_SPEED_RPM / 0.229f);
  dxl.writeControlTableItem(PROFILE_VELOCITY, MOTOR_ID, slow_vel);

  dxl.setGoalPosition(MOTOR_ID, CLOSE_POS_DEG, UNIT_DEGREE);

  uint32_t sweep_end = millis() + 8000UL;
  uint32_t next_sample = millis();
  uint16_t total = 0;
  float rawX[NUM_SENSORS], rawY[NUM_SENSORS], rawZ[NUM_SENSORS];

  while (millis() < sweep_end) {
    uint32_t now = millis();
    if (now < next_sample) continue;
    next_sample += SAMPLE_INTERVAL_MS;

    float enc = getEncoderDeg();
    if (enc >= CLOSE_POS_DEG - 0.3f) break;
    if (enc < OPEN_POS_DEG - 1.0f)   continue;

    int bin = encToProfileBin(enc);
    readAllSensorsRaw(rawX, rawY, rawZ);

    profile_count[bin]++;
    uint16_t n = profile_count[bin];
    for (int i = 0; i < NUM_SENSORS; i++) {
      motor_field_profile[bin][i][0] += (rawX[i] - motor_field_profile[bin][i][0]) / (float)n;
      motor_field_profile[bin][i][1] += (rawY[i] - motor_field_profile[bin][i][1]) / (float)n;
      motor_field_profile[bin][i][2] += (rawZ[i] - motor_field_profile[bin][i][2]) / (float)n;
    }
    total++;
  }

  dxl.writeControlTableItem(PROFILE_VELOCITY, MOTOR_ID, fast_vel);
  moveToOpen();
  delay(800);

  fillEmptyProfileBins();

  int populated = 0;
  for (int b = 0; b < PROFILE_NUM_BINS; b++) if (profile_count[b] > 0) populated++;

  profile_calibrated = (populated >= PROFILE_NUM_BINS / 2);

  DEBUG_SERIAL.print(F("# Profile sweep done. samples="));
  DEBUG_SERIAL.print(total);
  DEBUG_SERIAL.print(F(" populated_bins="));
  DEBUG_SERIAL.print(populated);
  DEBUG_SERIAL.print(F("/"));
  DEBUG_SERIAL.print(PROFILE_NUM_BINS);
  if (profile_calibrated) {
    DEBUG_SERIAL.println(F("  CALIBRATED."));
  } else {
    DEBUG_SERIAL.println(F("  TOO SPARSE - calibration FAILED."));
  }
  return profile_calibrated;
}

inline bool addrResponds(uint8_t addr) {
  Wire.beginTransmission(addr);
  return (Wire.endTransmission() == 0);
}

inline void tcaDisableAll() {
  Wire.beginTransmission(TCA_ADDR);
  Wire.write(0x00);
  Wire.endTransmission();
  delayMicroseconds(100);
}

// Initialize one sensor with retries (matches data_collection.ino behavior).
inline bool initOne(MLX90393& s, uint8_t a1, uint8_t a0,
                    int idx, const char* name) {
  uint8_t addr = 0x14 + (a1 << 1) + a0;
  const int RETRIES = 4;
  for (int attempt = 1; attempt <= RETRIES; attempt++) {
    if (addrResponds(addr)) {
      uint8_t st = s.begin(a1, a0);
      applyAmpSettings(s);
      sensor_present[idx] = (st == MLX90393::STATUS_OK);
      DEBUG_SERIAL.print(F("#   "));
      DEBUG_SERIAL.print(name);
      DEBUG_SERIAL.print(F(" begin status: 0x"));
      DEBUG_SERIAL.print(st, HEX);
      if (attempt > 1) {
        DEBUG_SERIAL.print(F(" (attempt "));
        DEBUG_SERIAL.print(attempt);
        DEBUG_SERIAL.print(F(")"));
      }
      DEBUG_SERIAL.println();
      return sensor_present[idx];
    }
    delay(50);
  }
  sensor_present[idx] = false;
  DEBUG_SERIAL.print(F("#   "));
  DEBUG_SERIAL.print(name);
  DEBUG_SERIAL.print(F("  NOT FOUND at 0x"));
  DEBUG_SERIAL.print(addr, HEX);
  DEBUG_SERIAL.print(F(" after "));
  DEBUG_SERIAL.print(RETRIES);
  DEBUG_SERIAL.println(F(" attempts - check power/wiring"));
  return false;
}

void initSensors() {
  DEBUG_SERIAL.println(F("# Initialising sensors..."));

  // Channel 0 - Index finger
  tcaselect(TCA_CH_INDEX);
  initOne(mlx_idx1, 0, 0, 0, "Idx1 (ID1)");
  initOne(mlx_idx2, 0, 1, 1, "Idx2 (ID2)");

  // Channel 1 - Thumb finger
  tcaselect(TCA_CH_THUMB);
  initOne(mlx_thb1, 1, 0, 2, "Thb1 (ID3)");
  initOne(mlx_thb2, 1, 1, 3, "Thb2 (ID4)");

  int alive = 0;
  for (int i = 0; i < NUM_SENSORS; i++) if (sensor_present[i]) alive++;
  DEBUG_SERIAL.print(F("# Sensors alive: "));
  DEBUG_SERIAL.print(alive);
  DEBUG_SERIAL.print(F("/"));
  DEBUG_SERIAL.println(NUM_SENSORS);

  delay(100);
  DEBUG_SERIAL.println(F("# Sensors OK (gain=2, res=0/0/0, OSR=2, DF=2, TCMP=on)."));
}

void calibrateBaseline() {
  DEBUG_SERIAL.println(F("# Calibrating baseline..."));

  float sumX[NUM_SENSORS] = {0};
  float sumY[NUM_SENSORS] = {0};
  float sumZ[NUM_SENSORS] = {0};

  for (int s = 0; s < BASELINE_SAMPLES; s++) {
    tcaselect(TCA_CH_INDEX);
    if (sensor_present[0]) { mlx_idx1.readData(data); sumX[0] += data.x; sumY[0] += data.y; sumZ[0] += data.z; }
    if (sensor_present[1]) { mlx_idx2.readData(data); sumX[1] += data.x; sumY[1] += data.y; sumZ[1] += data.z; }

    tcaselect(TCA_CH_THUMB);
    if (sensor_present[2]) { mlx_thb1.readData(data); sumX[2] += data.x; sumY[2] += data.y; sumZ[2] += data.z; }
    if (sensor_present[3]) { mlx_thb2.readData(data); sumX[3] += data.x; sumY[3] += data.y; sumZ[3] += data.z; }

    delay(SAMPLE_INTERVAL_MS);
  }

  for (int i = 0; i < NUM_SENSORS; i++) {
    if (sensor_present[i]) {
      baseline[i][0] = sumX[i] / BASELINE_SAMPLES;
      baseline[i][1] = sumY[i] / BASELINE_SAMPLES;
      baseline[i][2] = sumZ[i] / BASELINE_SAMPLES;
    } else {
      baseline[i][0] = 0; baseline[i][1] = 0; baseline[i][2] = 0;
    }
  }

  DEBUG_SERIAL.println(F("# Baseline done."));
}

// Returns (raw - baseline) per axis. If motor_field_profile is calibrated, uses
// the per-encoder-bin profile; otherwise falls back to static open-pos baseline.
inline void getBaseline(int sensor_idx, int bin, float* bx, float* by, float* bz) {
  if (profile_calibrated) {
    *bx = motor_field_profile[bin][sensor_idx][0];
    *by = motor_field_profile[bin][sensor_idx][1];
    *bz = motor_field_profile[bin][sensor_idx][2];
  } else {
    *bx = baseline[sensor_idx][0];
    *by = baseline[sensor_idx][1];
    *bz = baseline[sensor_idx][2];
  }
}

void readAllSensors(float dx[], float dy[], float dz[]) {
  float enc = getEncoderDeg();
  int bin = encToProfileBin(enc);
  float bx, by, bz;

  tcaselect(TCA_CH_INDEX);
  if (sensor_present[0]) {
    mlx_idx1.readData(data);
    getBaseline(0, bin, &bx, &by, &bz);
    dx[0] = data.x - bx; dy[0] = data.y - by; dz[0] = data.z - bz;
  } else { dx[0] = 0; dy[0] = 0; dz[0] = 0; }
  if (sensor_present[1]) {
    mlx_idx2.readData(data);
    getBaseline(1, bin, &bx, &by, &bz);
    dx[1] = data.x - bx; dy[1] = data.y - by; dz[1] = data.z - bz;
  } else { dx[1] = 0; dy[1] = 0; dz[1] = 0; }

  tcaselect(TCA_CH_THUMB);
  if (sensor_present[2]) {
    mlx_thb1.readData(data);
    getBaseline(2, bin, &bx, &by, &bz);
    dx[2] = data.x - bx; dy[2] = data.y - by; dz[2] = data.z - bz;
  } else { dx[2] = 0; dy[2] = 0; dz[2] = 0; }
  if (sensor_present[3]) {
    mlx_thb2.readData(data);
    getBaseline(3, bin, &bx, &by, &bz);
    dx[3] = data.x - bx; dy[3] = data.y - by; dz[3] = data.z - bz;
  } else { dx[3] = 0; dy[3] = 0; dz[3] = 0; }
}

// ==================================================================
// MOTOR FUNCTIONS
// ==================================================================

void initMotor() {
  DEBUG_SERIAL.println(F("# Initialising motor..."));
  dxl.begin(57600);
  dxl.setPortProtocolVersion(2.0);

  if (!dxl.ping(MOTOR_ID)) {
    DEBUG_SERIAL.println(F("# ERROR: XM430 not found. Check power, cable, ID=1 and baud=57600."));
    while (true) delay(1000);
  }

  dxl.torqueOff(MOTOR_ID);
  dxl.setOperatingMode(MOTOR_ID, OP_POSITION);

  int32_t vel_raw = (int32_t)(GRASP_SPEED_RPM / 0.229f);
  dxl.writeControlTableItem(PROFILE_VELOCITY, MOTOR_ID, vel_raw);

  dxl.torqueOn(MOTOR_ID);
  DEBUG_SERIAL.println(F("# Motor OK."));
}

void moveToOpen() {
  dxl.setGoalPosition(MOTOR_ID, OPEN_POS_DEG, UNIT_DEGREE);
}

float getEncoderDeg() {
  return dxl.getPresentPosition(MOTOR_ID, UNIT_DEGREE);
}
