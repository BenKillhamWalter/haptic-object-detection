/*
 * ================================================================
 *  PROSTHETIC HAND — INFERENCE FIRMWARE
 *  File: inference.ino
 * ================================================================
 *
 *  Prerequisites:
 *    model.h must be in this folder — generated by train_and_export.py
 *
 *  Hardware layout: identical to data_collection.ino
 *    OpenRB-150 + XM430-W350-R + TCA9548A + 6x MLX90393
 *
 *  Usage:
 *    - On power-up: calibrates baseline (fingers open, ~1 second)
 *    - Send 'g' over Serial (or press trigger pin) → executes grasp
 *    - Result printed to Serial as class name + confidence
 *    - Hand returns to open position
 *
 *  Feature vector: 56 values (must match train_and_export.py exactly)
 *    [0–17]  sensor deltas at t1 (18 values)
 *    [18–23] sensor magnitudes at t1 (6 values)
 *    [24]    encoder at t1
 *    [25–42] sensor deltas at t2 (18 values)
 *    [43–48] sensor magnitudes at t2 (6 values)
 *    [49]    encoder at t2
 *    [50–55] delta magnitude t2-t1 per sensor (6 values)
 *
 * ================================================================
 */

#include <Wire.h>
#include "MLX90393.h"
#include <Dynamixel2Arduino.h>
#include "model.h"   // Generated by train_and_export.py — must be in same folder

// ═══════════════════════════════════════════════════════════════════
//  ▶▶  TUNABLE PARAMETERS — keep in sync with data_collection.ino  ◀◀
// ═══════════════════════════════════════════════════════════════════

const float OPEN_POS_DEG       = 33.0;
const float CLOSE_POS_DEG      = 90.0;
const float GRASP_SPEED_RPM    = 10.0;

const uint32_t GRASP_TIMEOUT_MS   = 5000;
const uint32_t HOLD_DURATION_MS   = 800;
const float    CONTACT_THRESHOLD  = 40.0;
const float    ENCODER_STILL_DEG  = 0.5;
const uint8_t  ENCODER_STILL_COUNT= 5;
const uint32_t SAMPLE_INTERVAL_MS = 20;
const int      BASELINE_SAMPLES   = 40;

// ═══════════════════════════════════════════════════════════════════
//  SYSTEM CONSTANTS
// ═══════════════════════════════════════════════════════════════════

#define DXL_SERIAL   Serial1
#define DEBUG_SERIAL Serial
#define DXL_DIR_PIN  2
#define TCA_ADDR     0x70
#define MOTOR_ID     1
#define NUM_SENSORS  6
#define NUM_FEATURES 56

// Class names — must match the label strings used during training
// and the order produced by sklearn's LabelEncoder (alphabetical)
const char* CLASS_NAMES[4] = {
  "cube_soft",       // index 0
  "cube_stiff",      // index 1
  "cylinder_soft",   // index 2
  "cylinder_stiff"   // index 3
};

// ═══════════════════════════════════════════════════════════════════
//  SENSOR OBJECTS
// ═══════════════════════════════════════════════════════════════════

MLX90393 mlx_idx1, mlx_idx2;   // Strip 1, TCA ch0: Index  ID1, ID2
MLX90393 mlx_thb1, mlx_thb2;   // Strip 1, TCA ch0: Thumb  ID3, ID4
MLX90393 mlx_mid1, mlx_mid2;   // Strip 2, TCA ch1: Middle ID1, ID2

MLX90393::txyz data;
float baseline[NUM_SENSORS][3];

// ═══════════════════════════════════════════════════════════════════
//  DYNAMIXEL
// ═══════════════════════════════════════════════════════════════════

Dynamixel2Arduino dxl(DXL_SERIAL, DXL_DIR_PIN);
using namespace ControlTableItem;

// ═══════════════════════════════════════════════════════════════════
//  SETUP
// ═══════════════════════════════════════════════════════════════════

void setup() {
  DEBUG_SERIAL.begin(115200);
  while (!DEBUG_SERIAL && millis() < 4000);

  DEBUG_SERIAL.println(F("# Prosthetic Hand — Inference Firmware"));

  Wire.begin();
  initMotor();
  initSensors();
  calibrateBaseline();
  moveToOpen();

  DEBUG_SERIAL.println(F("# Ready. Send 'g' to grasp and classify."));
}

// ═══════════════════════════════════════════════════════════════════
//  MAIN LOOP
// ═══════════════════════════════════════════════════════════════════

void loop() {
  if (DEBUG_SERIAL.available()) {
    char c = DEBUG_SERIAL.read();
    if (c == 'g' || c == 'G') {
      runClassification();
    }
    if (c == 'r' || c == 'R') {
      // Re-calibrate baseline without reflashing
      calibrateBaseline();
    }
  }
}

// ═══════════════════════════════════════════════════════════════════
//  CLASSIFICATION GRASP
// ═══════════════════════════════════════════════════════════════════

void runClassification() {
  DEBUG_SERIAL.println(F("# Grasping..."));

  // Feature storage — values captured at t1 and t2
  float feat_t1_dx[NUM_SENSORS], feat_t1_dy[NUM_SENSORS], feat_t1_dz[NUM_SENSORS];
  float feat_t2_dx[NUM_SENSORS], feat_t2_dy[NUM_SENSORS], feat_t2_dz[NUM_SENSORS];
  float enc_t1 = 0.0f, enc_t2 = 0.0f;
  bool  t1_captured = false, t2_captured = false;

  bool     t1_detected = false;
  bool     t2_detected = false;
  uint8_t  still_count = 0;
  float    prev_enc    = getEncoderDeg();

  uint32_t grasp_start = millis();
  dxl.setGoalPosition(MOTOR_ID, CLOSE_POS_DEG, UNIT_DEGREE);

  uint32_t next_sample = millis();
  uint32_t timeout_end = grasp_start + GRASP_TIMEOUT_MS;
  bool     holding     = false;
  uint32_t hold_start  = 0;

  while (true) {
    uint32_t now = millis();
    if (holding && (now - hold_start >= HOLD_DURATION_MS)) break;
    if (!holding && now > timeout_end) {
      DEBUG_SERIAL.println(F("# WARNING: Timeout — no stable grasp detected."));
      break;
    }
    if (now < next_sample) continue;
    next_sample += SAMPLE_INTERVAL_MS;

    float enc = getEncoderDeg();
    float dx[NUM_SENSORS], dy[NUM_SENSORS], dz[NUM_SENSORS];
    readAllSensors(dx, dy, dz);

    // t1 detection
    if (!t1_detected) {
      for (int i = 0; i < NUM_SENSORS; i++) {
        if (fabs(dx[i]) > CONTACT_THRESHOLD ||
            fabs(dy[i]) > CONTACT_THRESHOLD ||
            fabs(dz[i]) > CONTACT_THRESHOLD) {
          t1_detected = true;
          break;
        }
      }
      if (t1_detected && !t1_captured) {
        // Snapshot feature values at t1
        enc_t1 = enc;
        for (int i = 0; i < NUM_SENSORS; i++) {
          feat_t1_dx[i] = dx[i];
          feat_t1_dy[i] = dy[i];
          feat_t1_dz[i] = dz[i];
        }
        t1_captured = true;
        DEBUG_SERIAL.println(F("# t1 captured"));
      }
    }

    // t2 detection
    if (t1_detected && !t2_detected) {
      float delta = fabs(enc - prev_enc);
      if (delta < ENCODER_STILL_DEG) {
        still_count++;
        if (still_count >= ENCODER_STILL_COUNT) {
          t2_detected = true;
          // Snapshot feature values at t2
          enc_t2 = enc;
          for (int i = 0; i < NUM_SENSORS; i++) {
            feat_t2_dx[i] = dx[i];
            feat_t2_dy[i] = dy[i];
            feat_t2_dz[i] = dz[i];
          }
          t2_captured = true;
          holding    = true;
          hold_start = now;
          DEBUG_SERIAL.println(F("# t2 captured"));
        }
      } else {
        still_count = 0;
      }
    }
    prev_enc = enc;
  }

  moveToOpen();

  // ── Classify ─────────────────────────────────────────────────
  if (!t1_captured || !t2_captured) {
    DEBUG_SERIAL.println(F("RESULT: UNKNOWN (grasp events not detected — check threshold)"));
    return;
  }

  float features[NUM_FEATURES];
  extractFeatures(
    feat_t1_dx, feat_t1_dy, feat_t1_dz, enc_t1,
    feat_t2_dx, feat_t2_dy, feat_t2_dz, enc_t2,
    features
  );

  // Run Random Forest (generated model.h provides this function)
  int predicted_class = predict(features);

  DEBUG_SERIAL.print(F("RESULT: "));
  if (predicted_class >= 0 && predicted_class < 4) {
    DEBUG_SERIAL.println(CLASS_NAMES[predicted_class]);
  } else {
    DEBUG_SERIAL.println(F("UNKNOWN"));
  }

  delay(500);
}

// ═══════════════════════════════════════════════════════════════════
//  FEATURE EXTRACTION
//  Must produce identical 56-value vector to train_and_export.py
// ═══════════════════════════════════════════════════════════════════

void extractFeatures(
  float* t1_dx, float* t1_dy, float* t1_dz, float enc_t1,
  float* t2_dx, float* t2_dy, float* t2_dz, float enc_t2,
  float* features
) {
  int idx = 0;

  // ── Group A: t1 readings ─────────────────────────────────────
  // [0–17] raw deltas
  for (int i = 0; i < NUM_SENSORS; i++) {
    features[idx++] = t1_dx[i];
    features[idx++] = t1_dy[i];
    features[idx++] = t1_dz[i];
  }
  // [18–23] per-sensor magnitudes at t1
  float mags_t1[NUM_SENSORS];
  for (int i = 0; i < NUM_SENSORS; i++) {
    mags_t1[i] = sqrt(t1_dx[i]*t1_dx[i] + t1_dy[i]*t1_dy[i] + t1_dz[i]*t1_dz[i]);
    features[idx++] = mags_t1[i];
  }
  // [24] encoder at t1
  features[idx++] = enc_t1;

  // ── Group B: t2 readings ─────────────────────────────────────
  // [25–42] raw deltas
  for (int i = 0; i < NUM_SENSORS; i++) {
    features[idx++] = t2_dx[i];
    features[idx++] = t2_dy[i];
    features[idx++] = t2_dz[i];
  }
  // [43–48] per-sensor magnitudes at t2
  float mags_t2[NUM_SENSORS];
  for (int i = 0; i < NUM_SENSORS; i++) {
    mags_t2[i] = sqrt(t2_dx[i]*t2_dx[i] + t2_dy[i]*t2_dy[i] + t2_dz[i]*t2_dz[i]);
    features[idx++] = mags_t2[i];
  }
  // [49] encoder at t2
  features[idx++] = enc_t2;

  // ── Group C: stiffness proxy (delta magnitude) ────────────────
  // [50–55] magnitude at t2 minus magnitude at t1 per sensor
  // Soft objects deform more between t1 and t2 → larger value
  for (int i = 0; i < NUM_SENSORS; i++) {
    features[idx++] = mags_t2[i] - mags_t1[i];
  }

  // Sanity check
  // idx should equal NUM_FEATURES (56) here
}

// ═══════════════════════════════════════════════════════════════════
//  SENSOR FUNCTIONS  (identical to data_collection.ino)
// ═══════════════════════════════════════════════════════════════════

void tcaselect(uint8_t ch) {
  if (ch > 7) return;
  Wire.beginTransmission(TCA_ADDR);
  Wire.write(1 << ch);
  Wire.endTransmission();
}

void initSensors() {
  tcaselect(0);
  mlx_idx1.begin(0,0); mlx_idx1.setOverSampling(0); mlx_idx1.setDigitalFiltering(0);
  mlx_idx2.begin(0,1); mlx_idx2.setOverSampling(0); mlx_idx2.setDigitalFiltering(0);
  mlx_thb1.begin(1,0); mlx_thb1.setOverSampling(0); mlx_thb1.setDigitalFiltering(0);
  mlx_thb2.begin(1,1); mlx_thb2.setOverSampling(0); mlx_thb2.setDigitalFiltering(0);

  tcaselect(1);
  mlx_mid1.begin(0,0); mlx_mid1.setOverSampling(0); mlx_mid1.setDigitalFiltering(0);
  mlx_mid2.begin(0,1); mlx_mid2.setOverSampling(0); mlx_mid2.setDigitalFiltering(0);

  delay(100);
}

void calibrateBaseline() {
  DEBUG_SERIAL.println(F("# Calibrating baseline..."));
  float sumX[NUM_SENSORS]={}, sumY[NUM_SENSORS]={}, sumZ[NUM_SENSORS]={};

  for (int s = 0; s < BASELINE_SAMPLES; s++) {
    tcaselect(0);
    mlx_idx1.readData(data); sumX[0]+=data.x; sumY[0]+=data.y; sumZ[0]+=data.z;
    mlx_idx2.readData(data); sumX[1]+=data.x; sumY[1]+=data.y; sumZ[1]+=data.z;
    mlx_thb1.readData(data); sumX[2]+=data.x; sumY[2]+=data.y; sumZ[2]+=data.z;
    mlx_thb2.readData(data); sumX[3]+=data.x; sumY[3]+=data.y; sumZ[3]+=data.z;
    tcaselect(1);
    mlx_mid1.readData(data); sumX[4]+=data.x; sumY[4]+=data.y; sumZ[4]+=data.z;
    mlx_mid2.readData(data); sumX[5]+=data.x; sumY[5]+=data.y; sumZ[5]+=data.z;
    delay(SAMPLE_INTERVAL_MS);
  }

  for (int i = 0; i < NUM_SENSORS; i++) {
    baseline[i][0] = sumX[i] / BASELINE_SAMPLES;
    baseline[i][1] = sumY[i] / BASELINE_SAMPLES;
    baseline[i][2] = sumZ[i] / BASELINE_SAMPLES;
  }
  DEBUG_SERIAL.println(F("# Baseline done."));
}

void readAllSensors(float dx[], float dy[], float dz[]) {
  tcaselect(0);
  mlx_idx1.readData(data); dx[0]=data.x-baseline[0][0]; dy[0]=data.y-baseline[0][1]; dz[0]=data.z-baseline[0][2];
  mlx_idx2.readData(data); dx[1]=data.x-baseline[1][0]; dy[1]=data.y-baseline[1][1]; dz[1]=data.z-baseline[1][2];
  mlx_thb1.readData(data); dx[2]=data.x-baseline[2][0]; dy[2]=data.y-baseline[2][1]; dz[2]=data.z-baseline[2][2];
  mlx_thb2.readData(data); dx[3]=data.x-baseline[3][0]; dy[3]=data.y-baseline[3][1]; dz[3]=data.z-baseline[3][2];
  tcaselect(1);
  mlx_mid1.readData(data); dx[4]=data.x-baseline[4][0]; dy[4]=data.y-baseline[4][1]; dz[4]=data.z-baseline[4][2];
  mlx_mid2.readData(data); dx[5]=data.x-baseline[5][0]; dy[5]=data.y-baseline[5][1]; dz[5]=data.z-baseline[5][2];
}

// ═══════════════════════════════════════════════════════════════════
//  MOTOR FUNCTIONS  (identical to data_collection.ino)
// ═══════════════════════════════════════════════════════════════════

void initMotor() {
  dxl.begin(57600);
  dxl.setPortProtocolVersion(2.0);
  if (!dxl.ping(MOTOR_ID)) {
    DEBUG_SERIAL.println(F("# ERROR: XM430 not found!"));
    while (true) delay(1000);
  }
  dxl.torqueOff(MOTOR_ID);
  dxl.setOperatingMode(MOTOR_ID, OP_POSITION);
  int32_t vel_raw = (int32_t)(GRASP_SPEED_RPM / 0.229f);
  dxl.writeControlTableItem(PROFILE_VELOCITY, MOTOR_ID, vel_raw);
  dxl.torqueOn(MOTOR_ID);
  DEBUG_SERIAL.println(F("# Motor OK."));
}

void moveToOpen() {
  dxl.setGoalPosition(MOTOR_ID, OPEN_POS_DEG, UNIT_DEGREE);
}

float getEncoderDeg() {
  return dxl.getPresentPosition(MOTOR_ID, UNIT_DEGREE);
}
